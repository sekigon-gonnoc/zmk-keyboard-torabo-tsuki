## config/west.yml
```yaml
manifest:
  remotes:
    - name: zmkfirmware
      url-base: https://github.com/zmkfirmware
    - name: sekigon-gonnoc
      url-base: https://github.com/sekigon-gonnoc
  projects:
    - name: zmk
      url: https://github.com/sekigon-gonnoc/zmk
      revision: v0.4+nemu-link
      import: app/west.yml
    - name: zmk-feature-nemu-link
      url: https://github.com/sekigon-gonnoc/zmk-feature-nemu-link
      revision: zmk-v0.4
      import: config/west.yml
    - name: zmk-feature-dynamic-settings
      remote: sekigon-gonnoc
    - name: zmk-feature-dynamic-input-processor
      remote: sekigon-gonnoc
    - name: zmk-feature-dynamic-macro
      remote: sekigon-gonnoc
    - name: zmk-feature-dynamic-combo
      remote: sekigon-gonnoc
    - name: zmk-feature-dynamic-tap-dance
      remote: sekigon-gonnoc
    - name: zmk-feature-dynamic-encoder
      remote: sekigon-gonnoc
    - name: zmk-feature-nemu-link-scan
      remote: sekigon-gonnoc
    - name: zmk-component-ble-micro-pro
      remote: sekigon-gonnoc
      revision: main
    - name: zmk-driver-kscan-74hc164-matrix
      remote: sekigon-gonnoc
    - name: zmk-feature-status-led
      remote: sekigon-gonnoc
      revision: main
    - name: zmk-feature-cdc-acm-bootloader-trigger
      remote: sekigon-gonnoc
      revision: main
    - name: zmk-feature-non-lipo-battery-management
      remote: sekigon-gonnoc
      revision: main
    - name: zmk-pmw3610-driver
      remote: sekigon-gonnoc
      revision: torabo-tsuki
  self:
    path: config
```
